  
#define CLOCK_PIN 4
#define CLOCK_PORT_PIN (1 << CLOCK_PIN)
#define DATA_PIN 3
#define DATA_PORT_PIN (1 << DATA_PIN)
#define KEYBOARD_READ_PIN 2
#define RESET_PIN 5

#define WRITE_DELAY 1

#define CHAR_BUFFER_SIZE 1024

unsigned const char scancodes[] = {
  0x0, 0x0, 0x0, 0x0, 0x0, 0x0, 0x0, 0x0, 0xe6, 0x0, 0xda, 0x0,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 0x0, 
};

volatile bool bufferEmpty = true;
char toWrite[CHAR_BUFFER_SIZE];
int readIndex = 0;
int writeIndex = 0;
unsigned long lastWrite = 0;


void enterScancode(char code) {
  bufferEmpty = false;
  lastWrite = millis();

  for (int i = 0; i < 10; ++i) {
    digitalWrite(DATA_PIN, code & 1);
    digitalWrite(CLOCK_PIN, LOW);
    digitalWrite(CLOCK_PIN, HIGH);
    code >>= 1;
  }
}

inline void appendScancode(char ch) {
  toWrite[writeIndex] = ch;
  writeIndex = (writeIndex + 1) % CHAR_BUFFER_SIZE;
}

inline void appendChar(char ch) {
  appendScancode(scancodes[ch]);
}


void registerRead() {
  bufferEmpty = true;
}

void resetComputer() {
  digitalWrite(CLOCK_PIN, HIGH);
  digitalWrite(DATA_PIN, LOW);
  digitalWrite(RESET_PIN, HIGH);
  delay(500);
  digitalWrite(RESET_PIN, LOW);
  bufferEmpty = true;
  readIndex = 0;
  writeIndex = 0;
}

void setup() {
  digitalWrite(CLOCK_PIN, HIGH);
  digitalWrite(DATA_PIN, LOW);
  digitalWrite(RESET_PIN, LOW);
  pinMode(CLOCK_PIN, OUTPUT);
  pinMode(DATA_PIN, OUTPUT);
  pinMode(RESET_PIN, OUTPUT);

  attachInterrupt(digitalPinToInterrupt(KEYBOARD_READ_PIN), registerRead, RISING);

  Serial.begin(9600);
}

void loop() {
  if (Serial.available() > 0) {
    char entered = Serial.read();
    if (entered == 0x01) {
      resetComputer();
    } else {
      if (entered == '\n') {
        appendChar('\n');
        appendScancode(0xf0);
      }
      appendChar(entered);
    }
  }

  if (bufferEmpty && writeIndex != readIndex && (millis() - lastWrite > WRITE_DELAY)) {
    char ch = toWrite[readIndex];
    readIndex = (readIndex + 1) % CHAR_BUFFER_SIZE;
    enterScancode(ch);
  }
}
